## sdkconfig.defaults
```kconfig
# Rust often needs a bit of an extra main task stack size compared to C (the default is 3K)
CONFIG_ESP_MAIN_TASK_STACK_SIZE=13000

# Use this to set FreeRTOS kernel tick frequency to 1000 Hz (100 Hz by default).
# This allows to use 1 ms granuality for thread sleeps (10 ms by default).
#CONFIG_FREERTOS_HZ=1000

# Workaround for https://github.com/espressif/esp-idf/issues/7631
CONFIG_MBEDTLS_CERTIFICATE_BUNDLE=y
CONFIG_MBEDTLS_CERTIFICATE_BUNDLE_DEFAULT_FULL=y

CONFIG_ESP_WIFI_SOFTAP_SUPPORT=false
CONFIG_ESP_WIFI_ENTERPRISE_SUPPORT=false
CONFIG_BT_ENABLED=false

CONFIG_LWIP_IPV6=false
CONFIG_NEWLIB_NANO_FORMAT=y

CONFIG_MBEDTLS_SERVER_SSL_SESSION_TICKETS=false
CONFIG_MBEDTLS_SSL_ALPN=false
CONFIG_MBEDTLS_SSL_RENEGOTIATION=false
CONFIG_MBEDTLS_CCM_C=false
CONFIG_MBEDTLS_SHA3_C=false
CONFIG_MBEDTLS_TLS_CLIENT_ONLY=y

CONFIG_VFS_SUPPORT_TERMIOS=false
CONFIG_VFS_SUPPORT_SELECT=false
CONFIG_VFS_SUPPORT_DIR=false
CONFIG_VFS_SUPPORT_IO=false
```
